## boards/shields/wings/Kconfig.shield
```kconfig
# No whitespace after the comma or in your part name!
config SHIELD_WINGS_LEFT
    def_bool $(shields_list_contains,wings_left)

# No whitespace after the comma or in your part name!
config SHIELD_WINGS_RIGHT
    def_bool $(shields_list_contains,wings_right)
```

## zmk-config/boards/shields/wings/Kconfig.defconfig
```kconfig
if SHIELD_WINGS_LEFT

# Name must be less than 16 characters long!
config ZMK_KEYBOARD_NAME
    default "Wings"

config ZMK_SPLIT_ROLE_CENTRAL
    default y

endif

if SHIELD_WINGS_LEFT || SHIELD_WINGS_RIGHT

config ZMK_SPLIT
    default y

endif
```
